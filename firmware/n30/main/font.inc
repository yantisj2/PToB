// Selected bitmap font from firmware/w12/legacy/display.cpp; original notices apply.
const uint8_t digits[10][5]={{0x3e,0x51,0x49,0x45,0x3e},{0,0x42,0x7f,0x40,0},
 {0x42,0x61,0x51,0x49,0x46},{0x21,0x41,0x45,0x4b,0x31},{0x18,0x14,0x12,0x7f,0x10},
 {0x27,0x45,0x45,0x45,0x39},{0x3c,0x4a,0x49,0x49,0x30},{0x01,0x71,0x09,0x05,0x03},
 {0x36,0x49,0x49,0x49,0x36},{0x06,0x49,0x49,0x29,0x1e}};
const uint8_t letters[26][5]={{0x7e,0x11,0x11,0x11,0x7e},{0x7f,0x49,0x49,0x49,0x36},
 {0x3e,0x41,0x41,0x41,0x22},{0x7f,0x41,0x41,0x22,0x1c},{0x7f,0x49,0x49,0x49,0x41},
 {0x7f,0x09,0x09,0x09,0x01},{0x3e,0x41,0x49,0x49,0x7a},{0x7f,0x08,0x08,0x08,0x7f},
 {0,0x41,0x7f,0x41,0},{0x20,0x40,0x41,0x3f,0x01},{0x7f,0x08,0x14,0x22,0x41},
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 {0x63,0x14,0x08,0x14,0x63},{0x07,0x08,0x70,0x08,0x07},{0x61,0x51,0x49,0x45,0x43}};
const uint8_t space[5]={},colon[5]={0,0x36,0x36,0,0},dash[5]={8,8,8,8,8};
const uint8_t dot[5]={0,0x60,0x60,0,0},slash[5]={0x20,0x10,8,4,2};
const uint8_t plus[5]={8,8,0x3e,8,8},percent[5]={0x23,0x13,8,0x64,0x62};
const uint8_t lower_a[5]={0x20,0x54,0x54,0x54,0x78};
const uint8_t lower_b[5]={0x7f,0x48,0x44,0x44,0x38};
const uint8_t lower_d[5]={0x38,0x44,0x44,0x48,0x7f};
const uint8_t lower_t[5]={0x04,0x3f,0x44,0x40,0x20};
const uint8_t arrow_glyph[5]={0,0x22,0x14,0x08,0};
const uint8_t lock_glyph[5]={0x78,0x7e,0x69,0x7e,0x78};
const uint8_t lower_u[5]={0x3c,0x40,0x40,0x20,0x7c};
const uint8_t lower_s[5]={0x48,0x54,0x54,0x54,0x24};
const uint8_t lower_c[5]={0x38,0x44,0x44,0x44,0x28};
const uint8_t lower_e[5]={0x38,0x54,0x54,0x54,0x18};
const uint8_t lower_h[5]={0x7f,0x08,0x04,0x04,0x78};
const uint8_t lower_i[5]={0,0x44,0x7d,0x40,0};
const uint8_t lower_k[5]={0x7f,0x10,0x28,0x44,0};
const uint8_t lower_l[5]={0,0x41,0x7f,0x40,0};
const uint8_t lower_m[5]={0x7c,0x04,0x78,0x04,0x78};
const uint8_t lower_n[5]={0x7c,0x08,0x04,0x04,0x78};
const uint8_t lower_o[5]={0x38,0x44,0x44,0x44,0x38};
const uint8_t lower_r[5]={0x7c,0x08,0x04,0x04,0x08};
const uint8_t lower_z[5]={0x44,0x64,0x54,0x4c,0x44};
const uint8_t* glyph(char c){
 if(c>='0'&&c<='9')return digits[c-'0'];
 if(c>='A'&&c<='Z')return letters[c-'A'];
 switch(c){case '\1':return lock_glyph;case '>':return arrow_glyph;case 'a':return lower_a;case 'b':return lower_b;case 'd':return lower_d;case 't':return lower_t;case ':':return colon;case '-':return dash;case '.':return dot;
 case '/':return slash;case '+':return plus;case '%':return percent;
 case 'u':return lower_u;case 's':return lower_s;
 case 'c':return lower_c;case 'e':return lower_e;case 'h':return lower_h;
 case 'i':return lower_i;case 'k':return lower_k;case 'l':return lower_l;
 case 'm':return lower_m;case 'n':return lower_n;case 'o':return lower_o;case 'r':return lower_r;
 case 'z':return lower_z;default:return space;}
}

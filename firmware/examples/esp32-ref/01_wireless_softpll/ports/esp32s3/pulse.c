// Copyright (c) 2026 Jonathan Yantis. SPDX-License-Identifier: MIT
// Optional 1 kHz electrical witness. No GPIO is selected by default.
// Edges are generated by MCPWM, never by a task toggling a pin. Initial software
// synchronization has UNKNOWN aperture/delay until separately measured.
#include "pulse.h"
#include "ref_local.h"
#include "radio.h"
#include "driver/mcpwm_prelude.h"
#include "esp_attr.h"
#include "freertos/FreeRTOS.h"
#include "freertos/task.h"
#include <math.h>
#include <stdatomic.h>

static mcpwm_timer_handle_t timer;
static mcpwm_oper_handle_t operator;
static mcpwm_cmpr_handle_t comparator;
static mcpwm_gen_handle_t generator;
static mcpwm_sync_handle_t sync_source;
static atomic_uint period_q16;
static atomic_bool stopped;
static uint32_t fraction;
static bool enabled, running, synchronized;

static bool IRAM_ATTR on_empty(mcpwm_timer_handle_t t, const mcpwm_timer_event_data_t *event, void *arg)
{
    (void)event; (void)arg;
    const uint32_t value = fraction + atomic_load(&period_q16);
    fraction = value & 65535;
    (void)mcpwm_timer_set_period(t, value >> 16);
    return false;
}
static bool IRAM_ATTR on_stop(mcpwm_timer_handle_t t, const mcpwm_timer_event_data_t *event, void *arg)
{ (void)t; (void)event; (void)arg; atomic_store(&stopped, true); return false; }

bool ref_pulse_begin(void)
{
    if (REF_PULSE_GPIO < 0) return true;
    atomic_store(&period_q16, 20000u << 16);
    mcpwm_timer_config_t tc = {0};
    tc.group_id = 0; tc.clk_src = MCPWM_TIMER_CLK_SRC_DEFAULT;
    tc.resolution_hz = 20000000; tc.period_ticks = 20000;
    tc.count_mode = MCPWM_TIMER_COUNT_MODE_UP;
    tc.flags.update_period_on_empty = true;
    mcpwm_operator_config_t oc = {.group_id = 0};
    mcpwm_comparator_config_t cc = {0}; cc.flags.update_cmp_on_tez = true;
    mcpwm_generator_config_t gc = {.gen_gpio_num = REF_PULSE_GPIO};
    if (mcpwm_new_timer(&tc, &timer) != ESP_OK || mcpwm_new_operator(&oc, &operator) != ESP_OK ||
        mcpwm_operator_connect_timer(operator, timer) != ESP_OK ||
        mcpwm_new_comparator(operator, &cc, &comparator) != ESP_OK ||
        mcpwm_comparator_set_compare_value(comparator, 20) != ESP_OK ||
        mcpwm_new_generator(operator, &gc, &generator) != ESP_OK) return false;
    if (mcpwm_generator_set_force_level(generator, 0, true) != ESP_OK ||
        mcpwm_generator_set_action_on_timer_event(generator,
            MCPWM_GEN_TIMER_EVENT_ACTION(MCPWM_TIMER_DIRECTION_UP, MCPWM_TIMER_EVENT_EMPTY, MCPWM_GEN_ACTION_HIGH)) != ESP_OK ||
        mcpwm_generator_set_action_on_compare_event(generator,
            MCPWM_GEN_COMPARE_EVENT_ACTION(MCPWM_TIMER_DIRECTION_UP, comparator, MCPWM_GEN_ACTION_LOW)) != ESP_OK) return false;
    mcpwm_soft_sync_config_t sc;
    const mcpwm_timer_event_callbacks_t callbacks = {.on_empty = on_empty, .on_stop = on_stop};
    if (mcpwm_new_soft_sync_src(&sc, &sync_source) != ESP_OK ||
        mcpwm_timer_register_event_callbacks(timer, &callbacks, NULL) != ESP_OK ||
        mcpwm_timer_enable(timer) != ESP_OK) return false;
    enabled = true;
    if (mcpwm_timer_start_stop(timer, MCPWM_TIMER_START_NO_STOP) != ESP_OK) return false;
    running = true;
    return true;
}

void ref_pulse_withdraw(void)
{
    if (generator) (void)mcpwm_generator_set_force_level(generator, 0, true);
    synchronized = false;
}

void ref_pulse_model(const RefClock *clock, bool qualified)
{
    if (!generator) return;
    uint64_t tick;
    RefClockReading reading;
    if (!qualified || !ref_counter_port_now(&tick) || !ref_clock_read(clock, tick, &reading)) {
        ref_pulse_withdraw(); return;
    }
    const int64_t backlog = reading.phase_remaining_ns;
    const double net_rate = clock->rate_ppb + (backlog > 0 ? (double)clock->slew_ppb :
                                             backlog < 0 ? -(double)clock->slew_ppb : 0);
    atomic_store(&period_q16, (uint32_t)llround(20000.0 * 65536 / (1 + net_rate / 1e9)));
    if (!synchronized) {
        mcpwm_timer_sync_phase_config_t phase = {0};
        phase.sync_src = sync_source;
        phase.count_value = (uint32_t)((uint64_t)reading.time_ns % 1000000 / 50);
        phase.direction = MCPWM_TIMER_DIRECTION_UP;
        if (mcpwm_timer_set_phase_on_sync(timer, &phase) != ESP_OK ||
            mcpwm_soft_sync_activate(sync_source) != ESP_OK ||
            mcpwm_generator_set_force_level(generator, -1, true) != ESP_OK) return;
        synchronized = true;
    }
}

bool ref_pulse_stop(void)
{
    ref_pulse_withdraw();
    if (running) {
        atomic_store(&stopped, false);
        if (mcpwm_timer_start_stop(timer, MCPWM_TIMER_STOP_EMPTY) != ESP_OK) return false;
        unsigned waited = 0;
        while (!atomic_load(&stopped) && waited++ < 100) vTaskDelay(pdMS_TO_TICKS(1));
        if (!atomic_load(&stopped)) return false;
        running = false;
    }
    if (enabled && mcpwm_timer_disable(timer) != ESP_OK) return false;
    enabled = false;
    if (generator && mcpwm_del_generator(generator) != ESP_OK) return false;
    generator = NULL;
    if (comparator && mcpwm_del_comparator(comparator) != ESP_OK) return false;
    comparator = NULL;
    if (operator && mcpwm_del_operator(operator) != ESP_OK) return false;
    operator = NULL;
    if (timer && mcpwm_del_timer(timer) != ESP_OK) return false;
    timer = NULL;
    if (sync_source && mcpwm_del_sync_src(sync_source) != ESP_OK) return false;
    sync_source = NULL;
    return true;
}

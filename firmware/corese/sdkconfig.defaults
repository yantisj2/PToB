## firmware/corese/sdkconfig.defaults
```kconfig
# Copyright (c) 2026 Jonathan Yantis. SPDX-License-Identifier: MIT
CONFIG_IDF_TARGET="esp32s3"
CONFIG_ESPTOOLPY_FLASHSIZE_16MB=y
CONFIG_ESPTOOLPY_FLASHMODE_QIO=y
CONFIG_ESPTOOLPY_FLASHFREQ_80M=y
CONFIG_ESP_DEFAULT_CPU_FREQ_MHZ_240=y
CONFIG_ESP_MAIN_TASK_STACK_SIZE=8192
CONFIG_ESP_MAIN_TASK_AFFINITY_CPU1=y
CONFIG_FREERTOS_HZ=1000
CONFIG_SPIRAM=y
CONFIG_SPIRAM_MODE_QUAD=y
CONFIG_SPIRAM_SPEED_80M=y
CONFIG_SPIRAM_USE_MALLOC=y
CONFIG_SPIRAM_MALLOC_RESERVE_INTERNAL=65536
# CONFIG_SPIRAM_ALLOW_BSS_SEG_EXTERNAL_MEMORY is not set
CONFIG_ESP_CONSOLE_USB_SERIAL_JTAG=y
# CONFIG_ESP_CONSOLE_SECONDARY_USB_SERIAL_JTAG is not set
# CONFIG_BT_ENABLED is not set
# CONFIG_ESP_WIFI_ENABLED is not set
# CONFIG_ESP_PHY_CALIBRATION_AND_DATA_STORAGE is not set
CONFIG_PARTITION_TABLE_SINGLE_APP=y
CONFIG_PARTITION_TABLE_OFFSET=0x8000
```

## firmware/examples/esp32-ref/01_wireless_softpll/sdkconfig.defaults
```kconfig
CONFIG_IDF_TARGET="esp32s3"
CONFIG_ESPTOOLPY_FLASHSIZE_16MB=y
CONFIG_ESPTOOLPY_FLASHMODE_DIO=y
CONFIG_ESP_DEFAULT_CPU_FREQ_MHZ_240=y
CONFIG_ESP_MAIN_TASK_STACK_SIZE=8192
CONFIG_ESP_CONSOLE_USB_SERIAL_JTAG=y
CONFIG_FREERTOS_HZ=1000
CONFIG_ESP_INT_WDT_TIMEOUT_MS=5000
CONFIG_ESP_TASK_WDT_TIMEOUT_S=5
CONFIG_BOOTLOADER_WDT_TIME_MS=9000
CONFIG_GPTIMER_CTRL_FUNC_IN_IRAM=y
CONFIG_MCPWM_CTRL_FUNC_IN_IRAM=y
CONFIG_MCPWM_ISR_CACHE_SAFE=y
# CONFIG_ESP_PHY_CALIBRATION_AND_DATA_STORAGE is not set
# CONFIG_ESP_WIFI_ENABLED is not set
CONFIG_BT_ENABLED=y
CONFIG_BT_NIMBLE_ENABLED=y
CONFIG_BT_NIMBLE_HOST_TASK_STACK_SIZE=8192
CONFIG_BT_NIMBLE_50_FEATURE_SUPPORT=y
CONFIG_BT_NIMBLE_EXT_ADV=y
CONFIG_BT_NIMBLE_EXT_SCAN=y
CONFIG_BT_NIMBLE_ENABLE_PERIODIC_ADV=y
CONFIG_BT_NIMBLE_ENABLE_PERIODIC_SYNC=y
# CONFIG_BT_NIMBLE_PERIODIC_ADV_ENH is not set
# CONFIG_BT_NIMBLE_ROLE_CENTRAL is not set
# CONFIG_BT_NIMBLE_ROLE_PERIPHERAL is not set
CONFIG_BT_NIMBLE_ROLE_OBSERVER=y
CONFIG_BT_NIMBLE_ROLE_BROADCASTER=y
CONFIG_BT_NIMBLE_MAX_CONNECTIONS=0
CONFIG_BT_NIMBLE_MAX_EXT_ADV_INSTANCES=2
CONFIG_BT_NIMBLE_EXT_ADV_MAX_SIZE=190
CONFIG_BT_NIMBLE_MAX_PERIODIC_SYNCS=1
# CONFIG_BT_NIMBLE_NVS_PERSIST is not set
# CONFIG_BT_NIMBLE_SECURITY_ENABLE is not set
CONFIG_BT_NIMBLE_PINNED_TO_CORE_0=y
CONFIG_BT_CTRL_PINNED_TO_CORE_0=y
CONFIG_BT_CTRL_BLE_MAX_ACT=6
CONFIG_BT_NIMBLE_MSYS_1_BLOCK_COUNT=12
CONFIG_BT_NIMBLE_MSYS_2_BLOCK_COUNT=12
CONFIG_BT_NIMBLE_TRANSPORT_EVT_COUNT=20
CONFIG_BT_NIMBLE_LOG_LEVEL_ERROR=y
CONFIG_PARTITION_TABLE_CUSTOM=y
CONFIG_PARTITION_TABLE_CUSTOM_FILENAME="partitions.csv"
CONFIG_PARTITION_TABLE_OFFSET=0x8000
```

## firmware/t096/boards/heltec/t096_r2/board.yml
```yaml
board:
  name: t096_r2
  full_name: Heltec HT-n5262G T096 V12 app-only candidate
  vendor: heltec
  socs:
    - name: nrf52840
```

## firmware/t096/boards/heltec/t096_r2/t096_r2_defconfig
```kconfig
CONFIG_ARM_MPU=y
CONFIG_HW_STACK_PROTECTION=y
CONFIG_GPIO=y
CONFIG_SERIAL=y
CONFIG_USE_DT_CODE_PARTITION=y
CONFIG_INIT_ARCH_HW_AT_BOOT=y
```

## firmware/w12/sdkconfig.defaults
```kconfig
CONFIG_IDF_TARGET="esp32s3"
CONFIG_ESPTOOLPY_FLASHSIZE_16MB=y
CONFIG_ESPTOOLPY_FLASHMODE_DIO=y
CONFIG_ESP_DEFAULT_CPU_FREQ_MHZ_240=y
CONFIG_ESP_MAIN_TASK_STACK_SIZE=12288
CONFIG_ESP_CONSOLE_USB_SERIAL_JTAG=y
CONFIG_FREERTOS_HZ=1000
CONFIG_ESP_INT_WDT_TIMEOUT_MS=5000
CONFIG_ESP_TASK_WDT_TIMEOUT_S=5
CONFIG_BOOTLOADER_WDT_TIME_MS=9000
CONFIG_PM_ENABLE=y
CONFIG_GPTIMER_CTRL_FUNC_IN_IRAM=y
# CONFIG_ESP_PHY_CALIBRATION_AND_DATA_STORAGE is not set
CONFIG_BT_ENABLED=y
CONFIG_BT_NIMBLE_ENABLED=y
CONFIG_BT_NIMBLE_HOST_TASK_STACK_SIZE=8192
CONFIG_BT_NIMBLE_50_FEATURE_SUPPORT=y
CONFIG_BT_NIMBLE_EXT_ADV=y
CONFIG_BT_NIMBLE_EXT_SCAN=y
CONFIG_BT_NIMBLE_ENABLE_PERIODIC_ADV=y
CONFIG_BT_NIMBLE_ENABLE_PERIODIC_SYNC=y
# CONFIG_BT_NIMBLE_PERIODIC_ADV_ENH is not set
# CONFIG_BT_NIMBLE_PERIODIC_ADV_WITH_RESPONSES is not set
CONFIG_BT_NIMBLE_MAX_EXT_ADV_INSTANCES=2
CONFIG_BT_NIMBLE_EXT_ADV_MAX_SIZE=191
CONFIG_BT_NIMBLE_MAX_PERIODIC_SYNCS=2
CONFIG_BT_NIMBLE_MAX_CONNECTIONS=4
CONFIG_BT_NIMBLE_ATT_PREFERRED_MTU=247
CONFIG_BT_NIMBLE_SM_SC_ONLY=1
CONFIG_BT_NIMBLE_ROLE_CENTRAL=y
CONFIG_BT_NIMBLE_ROLE_PERIPHERAL=y
CONFIG_BT_NIMBLE_ROLE_OBSERVER=y
CONFIG_BT_NIMBLE_ROLE_BROADCASTER=y
CONFIG_BT_NIMBLE_SECURITY_ENABLE=y
CONFIG_BT_NIMBLE_SM_SC=y
CONFIG_BT_NIMBLE_SM_LEGACY=n
CONFIG_BT_NIMBLE_NVS_PERSIST=n
CONFIG_BT_NIMBLE_PINNED_TO_CORE_0=y
CONFIG_BT_CTRL_PINNED_TO_CORE_0=y
CONFIG_BT_CTRL_BLE_MAX_ACT=6
CONFIG_BT_CTRL_BLE_SCAN=y
CONFIG_BT_CTRL_BLE_ADV=y
CONFIG_BT_CTRL_BLE_MASTER=y
CONFIG_BT_NIMBLE_MSYS_1_BLOCK_COUNT=16
CONFIG_BT_NIMBLE_MSYS_2_BLOCK_COUNT=16
CONFIG_BT_NIMBLE_TRANSPORT_EVT_COUNT=24
CONFIG_BT_NIMBLE_LOG_LEVEL_ERROR=y
CONFIG_MBEDTLS_HKDF_C=y
# CONFIG_ESP_WIFI_ENABLED is not set
CONFIG_PARTITION_TABLE_SINGLE_APP=y
CONFIG_PARTITION_TABLE_OFFSET=0x8000
```
